## subsys/dap/Kconfig
```kconfig
# Copyright (c) 2018-2019 PHYTEC Messtechnik GmbH
# SPDX-License-Identifier: Apache-2.0

menuconfig DAP
	bool "Debug Access Port support [EXPERIMENTAL]"
	select EXPERIMENTAL
	select DP_DRIVER
	help
	  Debug Access Port support (currently CMSIS DAP only)

if DAP

config CMSIS_DAP_PACKET_COUNT
	int "Maximum packet buffers for request and response data."
	default 4
	range 1 $(UINT8_MAX)
	help
	  Maximum packet buffers for request and response data.

config CMSIS_DAP_PROBE_VENDOR
	string "Probe vendor"
	default "Zephyr"

config CMSIS_DAP_PROBE_NAME
	string "Probe name"
	default "CMSIS-DAP"

config CMSIS_DAP_BOARD_VENDOR
	string "Target board vendor"
	default ""

config CMSIS_DAP_BOARD_NAME
	string "Target board name"
	default ""

config CMSIS_DAP_DEVICE_VENDOR
	string "Target device vendor"
	default ""

config CMSIS_DAP_DEVICE_NAME
	string "Target device name"
	default ""

config DAP_BACKEND_USB
	bool "USB backend (single packet)"
	depends on USB_DEVICE_STACK_NEXT
	help
	  DAP USB backend using bulk endpoints (one request, one response at a time).

config DAP_BACKEND_USB_QUEUE
	bool "USB backend with command queue (CMSIS-DAP Queue Commands)"
	depends on USB_DEVICE_STACK_NEXT
	depends on !DAP_BACKEND_USB
	help
	  DAP USB backend with request/response queues and DAP_QueueCommands (0x7E)
	  support. Allows multiple packets to be queued before execution.

module = DAP
module-str = dap
source "subsys/logging/Kconfig.template.log_config"

endif # DAP
```

## subsys/usb/device_next/class/Kconfig.cdc_acm
```kconfig
# Copyright (c) 2022 Nordic Semiconductor ASA
#
# SPDX-License-Identifier: Apache-2.0

config USBD_CDC_ACM_CLASS
	bool "USB CDC ACM implementation"
	depends on SERIAL
	depends on DT_HAS_ZEPHYR_CDC_ACM_UART_ENABLED
	select SERIAL_HAS_DRIVER
	select SERIAL_SUPPORT_INTERRUPT
	select RING_BUFFER
	select UART_INTERRUPT_DRIVEN
	default y
	help
	  USB device CDC ACM class implementation.

if USBD_CDC_ACM_CLASS

config USBD_CDC_ACM_WORKQUEUE
	bool "Use dedicated workqueue in CDC ACM"
	help
	  Use the dedicated queue in CDC ACM implementation if the systemwork
	  queue cannot be used due to performance issues or other conflicts.

config USBD_CDC_ACM_STACK_SIZE
	int "USB CDC ACM workqueue stack size"
	depends on USBD_CDC_ACM_WORKQUEUE
	default 1024
	help
	  USB CDC ACM workqueue stack size.

config USBD_CDC_ACM_BUF_POOL
	bool "Use dedicated buffer pool"
	default y if !USBD_MAX_SPEED_FULL
	help
	  Use a dedicated buffer pool whose size is based on the number of CDC
	  ACM instances and the size of the bulk endpoints. When disabled, the
	  implementation uses the UDC driver's pool.

config USBD_CDC_ACM_RX_PACKET_CALLBACK
	bool "Optional RX packet callback (one USB packet per callback)"
	default n
	help
	  When enabled, application can register a callback via
	  usbd_cdc_acm_register_rx_packet_cb(). Each completed Bulk OUT transfer
	  is delivered as one packet (data + len) to the callback instead of
	  being pushed to the UART ring buffer. Useful for packet-based
	  protocols (e.g. command/response). Callback runs in USB stack context;
	  it must copy data before return. When no callback is registered or
	  callback is NULL, behavior falls back to normal ring buffer.

module = USBD_CDC_ACM
module-str = usbd cdc_acm
default-count = 1
source "subsys/logging/Kconfig.template.log_config"

endif
```
